## CMakeLists.txt
```
# Find Zephyr. This also links to Zephyr's build system 
cmake_minimum_required(VERSION 3.20.0)

# set our board 
set(BOARD rpi_pico)

find_package(Zephyr)

# This is only used by IntelliSense inside VS Code 
set(CMAKE_EXPORT_COMPILE_COMMANDS ON)

# For using west flash with picoprobe
set(OPENOCD "openocd")
set(OPENOCD_DEFAULT_PATH "/usr/local/share/openocd/scripts")

#define project name
project(lab2_part2)

# Add source files
target_include_directories(app PRIVATE src/inc)
FILE(GLOB SRC_FILES "src/*.c")
target_sources(app PRIVATE src/main.c ${SRC_FILES})
```

## prj.conf
```kconfig
CONFIG_GPIO=y

# Enable UART0 for receiving data from the sensor node
CONFIG_UART_CONSOLE=y
CONFIG_SERIAL=y
CONFIG_UART_BAUD_RATE=115200
CONFIG_UART_0_NAME="UART_0"
CONFIG_UART_0_INIT_PRIORITY=60
CONFIG_UART_INTERRUPT_DRIVEN=y

# Enable UART1 for transmitting data to the sensor node
CONFIG_UART_1=y
CONFIG_UART_1_NAME="UART_1"
CONFIG_UART_1_INIT_PRIORITY=60
CONFIG_UART_1_BAUD_RATE=115200
CONFIG_UART_1_DATA_BITS=8
CONFIG_UART_1_STOP_BITS=1
CONFIG_UART_1_PARITY_NONE=y
CONFIG_UART_1_INTERRUPT_DRIVEN=y
```

## src/main.c
```c
#include <zephyr.h>
#include <drivers/uart.h>

const struct device *uart_rx_dev;
const struct device *uart_tx_dev;

void process_sensor_data(int sensor_data) {
    // Implement 
   
    printk("Received sensor data: %d\n", sensor_data);
}

int generate_command() {
    // Implement
    return 1;
}

void main(void) {
    uart_rx_dev = DEVICE_DT_GET(DT_NODELABEL(uart0));
    uart_tx_dev = DEVICE_DT_GET(DT_NODELABEL(uart1));

    while (1) {
        // Receive data from the sensor node using UART0
        int sensor_data;
        int ret = uart_rx(uart_rx_dev, (uint8_t *)&sensor_data, sizeof(sensor_data), SYS_FOREVER_MS);
        if (ret == 0) {
            process_sensor_data(sensor_data);
            // Send acknowledgement
            uint8_t ack = 0x06; // ASCII ACK character
            uart_tx(uart_tx_dev, &ack, 1, SYS_FOREVER_MS);
            printk("Sent acknowledgement\n");
        }

        // Transmit a command to the sensor node using UART1
        int command_data = generate_command();
        uart_tx(uart_tx_dev, (uint8_t *)&command_data, sizeof(command_data), SYS_FOREVER_MS);
        printk("Sent command: %d\n", command_data);

        // Wait for acknowledgement from the sensor node
        uint8_t ack;
        ret = uart_rx(uart_rx_dev, &ack, 1, K_SECONDS(1));
        if (ret == 0 && ack == 0x06) {
            printk("Received acknowledgement\n");
        } else {
            printk("Failed to receive acknowledgement\n");
        }

        k_msleep(1000);
    }
}
```
