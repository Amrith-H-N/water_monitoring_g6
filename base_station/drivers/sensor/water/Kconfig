## base_station/drivers/sensor/water/Kconfig
```kconfig
menuconfig WATER
    bool "Water Sensor Node"
    help
        Enable the Water Sensor Node.

if WATER

config WATER_UART_DEV_NAME
    string "UART device name"
    default "UART_0"
    help
        Specify the UART device name on the main system to be used for
        communication with the Water Sensor Node.

config WATER_UART_BAUD_RATE
    int "UART baud rate"
    default 115200
    help
        Set the baud rate for UART communication with the Water Sensor Node.
        This baud rate must match the configuration on the sensor node side
        for proper communication.


endif # WATER
choice
	prompt "WATER oversampling"
	default WATER_OVER_2X
	help
	  Select time oversampling for the WATER sensors.  Higher values
	  lead to more accurate readings, but higher power consumption.
config WATER_TEMP_OVER_1X
	bool "x1"
config WATER_TEMP_OVER_2X
	bool "x2"
config WATER_TEMP_OVER_4X
	bool "x4"
config WATER_TEMP_OVER_8X
	bool "x8"
config WATER_TEMP_OVER_16X
	bool "x16"
endchoice
.
choice
	prompt "WATER resolution"
	default WATER_RES_1X
	help
	  Select resolution for the WATER sensor.  Higher values
	  lead to more accurate readings, but higher power consumption.
config WATER_RES_1X
	bool "x1"
config WATER_RES_2X
	bool "x2"
endchoice
```

## base_station/dts/bindings/sensor/raspberry,rp2040.yaml
```yaml
# Copyright (c) 2022 Nordic Semiconductor ASA
# SPDX-License-Identifier: Apache-2.0

description: |
   Sensor node raspberry pi pico

compatible: "raspberry,rp2040"

include: base.yaml
```

## base_station/sample.yaml
```yaml
sample:
  name: UART driver sample
tests:
  sample.basic.button:
    tags: button gpio
    filter: dt_enabled_alias_with_parent_compat("sw0", "buttons")
    depends_on: gpio
    harness: button
  sample.drivers.uart:
    integration_platforms:
      - qemu_x86
    tags:
      - serial
      - uart
    filter: CONFIG_SERIAL and
            CONFIG_UART_INTERRUPT_DRIVEN and
            dt_chosen_enabled("zephyr,shell-uart")
    harness: keyboard
```
